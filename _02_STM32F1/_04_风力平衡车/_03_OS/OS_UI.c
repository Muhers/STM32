/*******************************(C) COPYRIGHT 2016 Vitamin（郭郭）*********************************/
/**============================================================================
* @FileName    : OS_UI.c

* -------------------------------------------- 
*  若要使用OS_UI 则要求完善该文件下的底层驱动
*=============================================================================*/

/* 头文件包含 ----------------------------------------------------------------*/
#include "OS_UI.h" 	 

/* 私有宏定义 ----------------------------------------------------------------*/

/* 私有（静态）函数声明 -------------------------------------------------------*/

/* 全局变量定义 --------------------------------------------------------------*/ 

/* 全局变量声明 --------------------------------------------------------------*/ 

/* 全局函数编写 --------------------------------------------------------------*/ 
/**----------------------------------------------------------------------------
* @FunctionName  : OS_UI_Init()     
* @Description   : UI初始化函数
* @Data          : 2016/7/26
* @Explain        
-------------------------------------------------------------------------------  
None
------------------------------------------------------------------------------*/ 
void OS_UI_Init(void) 
{   
	OLED_Init();   
	OS_Clear();		
}	

 

/**----------------------------------------------------------------------------
* @FunctionName  : OS_Clear()     
* @Description   : 清屏函数 
* @Data          : 2016/7/26
* @Explain        
-------------------------------------------------------------------------------
* None
------------------------------------------------------------------------------*/
void OS_Clear(void)
{
	OLED_CLS(); 
}
 

 
/**----------------------------------------------------------------------------
* @FunctionName  : OS_String_Show()     
* @Description   : 打印句子 
* @Data          : 2016/7/26
* @Explain        
-------------------------------------------------------------------------------
* x,y 坐标    *str 语句指针   size 字体大小   
------------------------------------------------------------------------------*/ 
void OS_String_Show(u16 x, u16 y, u8 *str)
{  
	uint16_t x0 = x;
    uint8_t bHz = 0;   //字符或者中文 
	static u8 UseState = 0; 
	
	if(UseState) return;
	UseState = 1;  
 
	y *= 2;
	x*= 16;
    while(*str != 0)		//数据未结束
    {
        if(!bHz)
        {
            if(*str > 0x80)bHz = 1; //中文
            else              //字符
            {
                if(*str == 13) //换行符号
                {
                    y += 2;
                    x = x0;
                    str++;
                } 
                LcdDisplay_HZ(x, y,str); 
                str++;
                x += 8; //字符,为全字的一半 
            } 
        }
        else //中文
        {	
            bHz = 0; //有汉字库	
            LcdDisplay_HZ(x,y,str);	
            str += 2;
            x += 16; //下一个汉字偏移	
        }
    } 
	UseState = 0;
}

 
/**----------------------------------------------------------------------------
* @FunctionName  : OS_Decim_Show()     
* @Description   : 打印小数 
* @Data          : 2016/7/26
* @Explain        
------------------------------------------------------------------------------- 
x,y 坐标    num 数值   size 字体大小   
DecimLenth 小数长度     NumLenth 整数长度 
------------------------------------------------------------------------------*/ 
 void OS_Decim_Show(u16 x,u16 y,double num,u8 NumLenth,u8 DecimLenth)
{ 	                         
	volatile unsigned long int sNum,sDecim;                  
	volatile unsigned long int temp;  
	unsigned char ch[32] = {0},flag = 0;	
	unsigned int cnt = 0;

		
	ch[0] = ' ';	
	if(num < 0.0f)	
	{	
		num = -num;		
		ch[0] = '-';	
	} 	
	
	sNum = (unsigned long int)num;		
	sDecim = (num - sNum + 0.0000000000001f)*pow(10,DecimLenth);//保留digit位小数，弥补double型正负的误差	
 
	while(NumLenth--) //显示整数
	{ 
		temp = pow(10,NumLenth); 
		ch[++cnt] = '0' + sNum/temp;
		
		if(flag == 0)
		{
			if(ch[cnt] == '0') ch[cnt] = ' '; 
			else flag = 1;
		}
	
		sNum -= (sNum/temp)*temp; 
	} 
	if(ch[cnt] == ' ') ch[cnt] = '0'; 
	if(DecimLenth != 0)//显示小数部分
	{
		ch[++cnt] = '.';
		  
		while(DecimLenth--) 
		{ 
			temp = pow(10,DecimLenth); 
			ch[++cnt] = '0' + sDecim/temp;
			sDecim -= (sDecim/temp)*temp; 
		}  
	} 
	OS_String_Show(x,y,ch); 
	
} 


/**----------------------------------------------------------------------------
* @FunctionName  : OS_Num_Show()     
* @Description   : 打印整数	
* @Data          : 2016/7/26
* @Explain        
-------------------------------------------------------------------------------  
x,y 坐标    num 数值   size 字体大小   
NumLenth 整数长度
------------------------------------------------------------------------------*/ 
void OS_Num_Show(u16 x,u16 y,signed long int num,u8 NumLenth) 
{    
	OS_Decim_Show(x,y,num,NumLenth,0); 
}
	
	
		
/*******************************(C) COPYRIGHT 2016 Vitamin（郭郭）*********************************/
		
		
		
	
	
	

